## sw/fw_pic/dts/bindings/fw_pic.yaml
```yaml
description: Featherweight IP programmable interrupt controller

compatible: "fw_pic"

include: [interrupt-controller.yaml, base.yaml]

properties:
    reg:
        required: true
    
    "#interrupt-cells":
        const: 1
        
    num-irqs:
        type: int
        required: true
        description: Number of IRQs the intc supports
        
    irq:
        type: int
        required: true
        description: Interrupt index for PIC
        
interrupt-cells:
    - irq
    
```

## sw/fw_pic/zephyr/Kconfig
```kconfig
menuconfig FW_PIC
        bool "Featherweight IP PIC"
        default y
#       select TICKLESS_CAPABLE
        help
          This module implements a kernel device driver for the 
          Featherweight IP programmable interrupt controller

          
```
